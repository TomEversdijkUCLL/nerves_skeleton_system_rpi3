## Config.in
```kconfig
# Add project-specific packages for Buildroot here
#
# If these are non-proprietary, please consider contributing them back to
# Nerves or Buildroot.


source "$NERVES_DEFCONFIG_DIR/packages/python-imutils/Config.in"
source "$NERVES_DEFCONFIG_DIR/packages/python-opencv/Config.in"
```

## packages/python-imutils/Config.in
```kconfig
config BR2_PACKAGE_IMUTILS
        bool "imutils"
        help
          https://pypi.org/project/imutils/
```
